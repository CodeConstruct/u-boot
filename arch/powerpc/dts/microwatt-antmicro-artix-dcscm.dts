#include "microwatt.dts"

/ {
	memory@0 {
		device_type = "memory";
		reg = <0x00000000 0x00000000 0x00000000 0x20000000>;
	};
};

&litemmc  {
	/* eMMC on the DC-SCM, and we have all 8 data lines */
	non-removable;
	bus-width = <8>;
};
