## arch/powerpc/cpu/microwatt/Kconfig
```kconfig
menu "microwatt CPU"
	depends on MICROWATT

config SYS_CPU
	default "microwatt"

choice
	prompt "Target select"
	optional

config TARGET_ARTY_A7
	bool "Support Arty A7 board"

endchoice

source "board/arty_a7/Kconfig"

endmenu
```

## board/arty_a7/Kconfig
```kconfig
if TARGET_ARTY_A7

config SYS_BOARD
	default "arty_a7"

config SYS_CONFIG_NAME
	default "microwatt"

config LITEX_SUPPORT
	bool "Support Litex peripherals"
	default y
	help
	  This enables the infrastructure for access to Litex peripheral
	  devices (e.g. litesdcard or liteeth).

config LITEX_SUBREG_SIZE
	int "Litex sub-register size"
	depends on LITEX_SUPPORT
	default 4
	help
	  Registers in Litex peripherals are presented as an array of
	  subregisters of either 1 or 4 bytes; this specifies the size
	  in bytes of each subregister.  Say 4 if not sure.

endif
```

## configs/microwatt_antmicro_artix_dcscm_defconfig
```kconfig
CONFIG_PPC=y
CONFIG_SYS_TEXT_BASE=0x0c000000
CONFIG_ENV_SIZE=0x10000
CONFIG_ENV_OFFSET=0x3f0000
CONFIG_ENV_SECT_SIZE=0x10000
CONFIG_DEFAULT_DEVICE_TREE="microwatt-antmicro-artix-dcscm"
CONFIG_MICROWATT=y
CONFIG_TARGET_ARTY_A7=y
CONFIG_PHYS_64BIT=y
CONFIG_OF_STDOUT_VIA_ALIAS=y
CONFIG_LOG=y
CONFIG_CMD_DM=y
CONFIG_CMD_LSBLK=y
CONFIG_CMD_MMC=y
CONFIG_CMD_SPI=y
CONFIG_DEFAULT_SPI_MODE=0x0
CONFIG_CMD_DHCP=y
CONFIG_BOOTP_PREFER_SERVERIP=y
CONFIG_CMD_MDIO=y
CONFIG_CMD_PING=y
CONFIG_CMD_EXT4=y
CONFIG_DOS_PARTITION=y
CONFIG_OF_CONTROL=y
CONFIG_OF_LIVE=y
CONFIG_OF_EMBED=y
CONFIG_ENV_IS_IN_SPI_FLASH=y
CONFIG_ENV_SECT_SIZE_AUTO=y
CONFIG_ENV_SPI_MAX_HZ=12500000
CONFIG_DM=y
CONFIG_DM_DEBUG=y
CONFIG_REGMAP=y
CONFIG_SYSCON=y
CONFIG_DEVRES=y
CONFIG_SIMPLE_BUS_CORRECT_RANGE=y
CONFIG_CLK=y
CONFIG_MMC_LITEX=y
CONFIG_DM_SPI_FLASH=y
CONFIG_SF_DEFAULT_MODE=0x3
CONFIG_SPI_FLASH_BAR=y
# CONFIG_SPI_FLASH_UNLOCK_ALL is not set
CONFIG_SPI_FLASH_SPANSION=y
CONFIG_SPI_FLASH_WINBOND=y
CONFIG_PHYLIB=y
CONFIG_PHY_MSCC=y
CONFIG_PHY_SMSC=y
CONFIG_DM_ETH=y
CONFIG_DM_MDIO=y
CONFIG_LITEETH=y
# CONFIG_PCI is not set
CONFIG_SPECIFY_CONSOLE_INDEX=y
CONFIG_DM_SERIAL=y
CONFIG_SERIAL_RX_BUFFER=y
CONFIG_SYS_NS16550=y
CONFIG_SPI=y
CONFIG_DM_SPI=y
CONFIG_MICROWATT_SPI=y
CONFIG_OF_LIBFDT_ASSUME_MASK=0x0
CONFIG_OF_LIBFDT_OVERLAY=y
```
